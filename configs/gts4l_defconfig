## configs/gts4l_defconfig
```kconfig
CONFIG_LINUX_KRNL_HEADER_IMG=y

CONFIG_SIMPLE_FB=y
CONFIG_EARLYCON=y

CONFIG_MSM8998=y
CONFIG_SAMSUNG_GTS4L=y

CONFIG_TEXT_BASE=0x100000000
CONFIG_PAYLOAD_ENTRY=0x95700000
CONFIG_RAMDISK_ENTRY=0x98800000

CONFIG_POSITION_INDEPENDENT=y
CONFIG_COMPRESS_GZIP=y
```

## configs/gts4llte_defconfig
```kconfig
CONFIG_LINUX_KRNL_HEADER_IMG=y
CONFIG_SIMPLE_FB=y
CONFIG_MSM8998=y
CONFIG_SAMSUNG_GTS4LLTE=y
CONFIG_PAYLOAD_ENTRY=0xa1080000
CONFIG_RAMDISK_ENTRY=0xa5000000
CONFIG_DTB_ENTRY=0xa9000000
CONFIG_TEXT_BASE=0x100000000
CONFIG_POSITION_INDEPENDENT=y
CONFIG_COMPRESS_GZIP=y
```
